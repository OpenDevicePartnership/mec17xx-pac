# MEC1703K register map
Vendor: Microchip Technology; Series: MEC1703; File version: 0
Microchip MEC1703K Microcontroller
CPU: CM4 r1p0, little endian, MPU, FPU, 3 interrupt priority bits, 156 interrupts
Registers are 32-bit, read-write, reset 0x0 unless marked. A register's access mark holds for its fields unless they carry their own. Offsets are from the block's base; lines under a group give offsets from that group; [hi:lo] are bit positions; {n}, {i} and the like mark numbered series; 'fields as' and 'values as' point back to an identical list; <NAME> marks a mode.

## Memory map
0x40000000 WDT size 0xE — The function of the Watchdog Timer is to provide a mechanism to detect if the internal embedded controller has failed. When enabled, the Watchdog Timer (WDT) circuit will generate a WDT Event if the user program fails to reload the WDT within a specified length of time known as the WDT Interval.
0x40000C00 TIMER16_0 size 0x14 — This timer block offers a simple mechanism for firmware to maintain a time base. This timer may be instantiated as 16 bits. The name of the timer instance indicates the size of the timer.
0x40000C20 TIMER16_1 size 0x14
0x40000C40 TIMER16_2 size 0x14
0x40000C80 TIMER16_3 size 0x14
0x40000C80 TIMER32_0 size 0x14 — This timer block offers a simple mechanism for firmware to maintain a time base. This timer may be instantiated as. 32 bits. The name of the timer instance indicates the size of the timer.
0x40000CA0 TIMER32_1 size 0x14
0x40000D00 CNT_TMR0 size 0x10 — This interface is a 16-bit auto-reloading timer/counter.
0x40000D20 CNT_TMR1 size 0x10
0x40000D40 CNT_TMR2 size 0x10
0x40000D60 CNT_TMR3 size 0x10
0x40001000 CCT size 0x30 — This is a 16-bit auto-reloading timer/counter.
0x40001400 RC_ID0 size 0x8 — This interface provides a single pin interface which can discriminate a number of quantized RC constants.
0x40001480 RC_ID1 size 0x8
0x40001500 RC_ID2 size 0x8
0x40002400 DMA_MAIN size 0x8 — DMA Main Registers
0x40002440 DMA_CHAN00 size 0x2C — DMA Channel 00 Registers
0x40002480 DMA_CHAN01 size 0x2C — DMA Channel 01 Registers
0x400024C0 DMA_CHAN02 size 0x19 — DMA Channel 00 Registers
{0x40002440+0x40*n} DMA_CHAN{n:02} size 0x19 (n=3..13)
0x40002C00 EEPROM size 0x40 — This block is the 2K x 8bit EEPROM.
0x40004000 SMB0 size 0x68 — The SMBus interface can handle standard SMBus 2.0 protocols as well as I2C interface.
0x40004400 SMB1 size 0x68
0x40004800 SMB2 size 0x68
0x40004C00 SMB3 size 0x68
0x40005400 QMSPI size 0x44 — The Quad SPI Master Controller may be used to communicate with various peripheral devices that use a Serial Peripheral Interface, such as EEPROMS, DACs and ADCs. The controller can be configured to support advanced SPI Flash devices with multi-phase access protocols.
0x40005800 PWM0 size 0xC — This block generates a PWM output that can be used to control 4-wire fans, blinking LEDs, and other similar devices. Each PWM can generate an arbitrary duty cycle output at frequencies from less than 0.1 Hz to 24 MHz. The PWM controller can also used to generate the PROCHOT output and Speaker output.
{0x40005800+0x10*n} PWM{n} size 0xC (n=1..11)
0x40006000 TACH0 size 0x10 — This block monitors TACH output signals (or locked rotor signals) from various types of fans, and determines their speed.
0x40006010 TACH1 size 0x10
0x40006020 TACH2 size 0x10
0x40006400 PECI size 0x48 — The PECI Interface allows the EC to retrieve temperature readings from PECI-compliant devices.
0x40007400 RTOS size 0x10 — The RTOS Timer is a low-power, 32-bit timer designed to operate on the 32kHz oscillator which is available during all chip sleep states. This allows firmware the option to sleep the processor, enter heavy or deep chip sleep states, and wake after a programmed amount of time. The timer may be used as a one-shot timer or a continuous timer. When the timer transitions to 0 it is capable of generating a wake-capable interrupt to the embedded controller. This timer may be halted during debug by hardware or via a software control bit.
0x40007C00 ADC size 0x6C — This block is designed to convert external analog voltage readings into digital values.
0x40008C00 TFDP size 0x5 — The TFDP serially transmits Embedded Controller (EC)-originated diagnostic vectors to an external debug trace system.
0x40009000 PS2_0 size 0xC — There are four PS/2 Ports which are directly controlled by the EC. The hardware implementation eliminates the need to bit bang I/O ports to generate PS/2 traffic, however bit banging is available via the associated GPIO pins.
0x40009040 PS2_1 size 0xC
0x40009080 PS2_2 size 0xC
0x40009400 GP_SPI0 size 0x1C — The General Purpose Serial Peripheral Interface (GP-SPI) may be used to communicate with various peripheral devices, e.g., EEPROMS, DACs, ADCs, that use a standard Serial Peripheral Interface.
0x40009480 GP_SPI1 size 0x1C
0x40009800 HTM0 size 0xA — The Hibernation Timer can generate a wake event to the Embedded Controller (EC) when it is in a hibernation mode. This block supports wake events up to 2 hours in duration. The timer is a 16-bit binary count-down timer that can be programmed in 30.5us and 0.125 second increments for period ranges of 30.5us to 2s or 0.125s to 136.5 minutes, respectively.
0x40009820 HTM1 size 0xA
0x40009C00 KMS size 0x18 — The Keyboard Scan Interface block provides a register interface to the EC to directly scan an external keyboard matrix of size up to 18x8.
0x4000A000 FAN0 size 0x12 — The RPM-PWM Interface is an RPM based Fan Control Algorithm that monitors the fan's speed and automatically adjusts the drive to maintain the desired fan speed. This RPM based Fan Control Algorithm controls a PWM output based on a tachometer input.
0x4000A080 FAN1 size 0x12
0x4000A400 VBAT size 0x2C — The VBAT Register Bank block is a block implemented for aggregating miscellaneous battery-backed registers required the host and by the Embedded Controller (EC) Subsystem that are not unique to a block implemented in the EC subsystem.
0x4000A800 VBAT_RAM size 0xC8 — The VBAT Powered RAM provides a 128 Byte Random Accessed Memory that is operational while the main power rail is operational, and will retain its values powered by battery power while the main rail is unpowered.
0x4000AC80 WEEK size 0x28 — The Week Alarm Interface provides two timekeeping functions: a Week Timer and a Sub-Week Timer. Both the Week Timer and the Sub-Week Timer assert the Power-Up Event Output which automatically powers-up the system from the G3 state.
0x4000AE00 VCI size 0x24 — The VBAT-Powered Control Interface has VBAT-powered combinational logic and input and output signal pins. The block interfaces with the RTC With Date and DST Adjustment as well as the Week Alarm.
0x4000B800 LED0 size 0x18 — The blinking/breathing hardware is implemented using a PWM. The PWM can be driven either by the 48 MHz clock or by a 32.768 KHz clock input. When driven by the 48 MHz clock, the PWM can be used as a standard 8-bit. PWM in order to control a fan. When used to drive blinking or breathing LEDs, the 32.768 KHz clock source is used.
0x4000B900 LED1 size 0x18
0x4000BA00 LED2 size 0x18
0x4000BB00 LED3 size 0x18
0x4000E000 ECIA size 0x20C — The interrupt generation logic is made of 16 groups of signals, each of which consist of a Status register, a Enable register and a Result register. The Status and Enable are latched registers. The Result register is a bit by bit AND function of the Source and Enable registers. All the bits of the Result register are OR'ed together and AND'ed with the corresponding bit in the Block. Select register to form the interrupt signal that is routed to the ARM interrupt controller.
0x4000FC04 EC_REG_BANK size 0x88 — This block is designed to be accessed internally by the EC via the register interface.
0x40080100 PCR size 0x84 — The Power, Clocks, and Resets (PCR) Section identifies all the power supplies, clock sources, and reset inputs to the chip and defines all the derived power, clock, and reset signals.
0x40081000 GPIO size 0x7B0 — GPIO Pin Control Registers
0x40082000 EFUSE size 0x4B0 — The eFUSE block provides a means of programming and accessing the eFUSE bits.
0x400F0000 MBX size 0x130 — The Mailbox provides a standard run-time mechanism for the host to communicate with the Embedded Controller (EC).
0x400F0400 KBC size 0x331 — The keyboard controller uses the EC to produce a superset of the features provided by the industry-standard 8042 keyboard controller. The 8042 Emulated Keyboard Controller is a Host/EC. Message Interface with hardware assists to emulate 8042 behavior and provide Legacy GATEA20 support.
0x400F0800 ACPI_EC0 size 0x10C — The ACPI Embedded Controller Interface (ACPI-ECI) provides a four byte full duplex data interface which is a superset of the standard ACPI Embedded Controller Interface (ACPI-ECI) one byte data interface. The ACPI Embedded Controller Interface (ACPI-ECI) defaults to the standard one byte interface.
0x400F0C00 ACPI_EC1 size 0x10C
0x400F1000 ACPI_EC2 size 0x10C
0x400F1400 ACPI_EC3 size 0x10C
0x400F1800 ACPI_EC4 size 0x10C
0x400F1C00 PM1 size 0x111 — The device implements the ACPI fixed registers but includes only those bits that apply to the power button sleep button and RTC alarm events. The ACPI WAK_STS, SLP_TYP and SLP_EN bits are also supported.
0x400F2400 UART0 size 0x3F1 — The 16550 UART (Universal Asynchronous Receiver/Transmitter) is a full-function Two Pin Serial Port that supports the standard RS-232 Interface.
0x400F2800 UART1 size 0x3F1
0x400F4000 EMI0 size 0x118 — The Embedded Memory Interface (EMI) provides a standard run-time mechanism for the system host to communicate with the Embedded Controller (EC) and other logical components.
0x400F4400 EMI1 size 0x118
0x400F4800 EMI2 size 0x118
0x400F5000 RTC size 0x20 — This is the set of registers that are automatically counted by hardware every 1 second while the block is enabled to run and to update. These registers are: Seconds, Minutes, Hours, Day of Week, Day of Month, Month, and Year.
0x400FFF00 GCR size 0x22 — The Logical Device Configuration registers support motherboard designs in which the resources required by their components are known and assigned by the BIOS at POST.
0xE000E000 SystemControl size 0xD8C — System Control Registers
0xE000E010 SysTick size 0x10 — System timer
0xE000E100 NVIC size 0xE04 — Nested Vectored Interrupt Controller
0xE000ED90 MPU size 0x14 — Memory Protection Unit Registers

## Interrupts
0 GIRQ08 (GPIO)
1 GIRQ09 (GPIO)
2 GIRQ10 (GPIO)
3 GIRQ11 (GPIO)
4 GIRQ12 (GPIO)
17 GIRQ26 (GPIO)
20 SMB0
21 SMB1
22 SMB2
23 SMB3
{n+24} DMA_CH{n:02} (DMA_CHAN{n:02}) (n=0..13)
40 UART0
41 UART1
42 EMI0
43 EMI1
44 EMI2
45 IBF0 (ACPI_EC0)
46 OBE0 (ACPI_EC0)
47 IBF1 (ACPI_EC1)
48 OBE1 (ACPI_EC1)
49 IBF2 (ACPI_EC2)
50 OBE2 (ACPI_EC2)
51 IBF3 (ACPI_EC3)
52 OBE3 (ACPI_EC3)
53 IBF4 (ACPI_EC4)
54 OBE4 (ACPI_EC4)
55 ACPIPM1_CTL (PM1)
56 ACPIPM1_EN (PM1)
57 ACPIPM1_STS (PM1)
58 KBC8042_OBE (KBC)
59 KBC8042_IBF (KBC)
60 MBX
70 PECI
71 TACH0
72 TACH1
73 TACH2
74 RPM2PWM_0_FAIL (FAN0)
75 RPM2PWM_0_STALL (FAN0)
76 RPM2PWM_1_FAIL (FAN1)
77 RPM2PWM_1_STALL (FAN1)
78 SNGL (ADC)
79 RPT (ADC)
80 RC_ID0
81 RC_ID1
82 RC_ID2
83 LED0
84 LED1
85 LED2
86 LED3
91 QMSPI
92 TX0 (GP_SPI0)
93 RX0 (GP_SPI0)
94 TX1 (GP_SPI1)
95 RX1 (GP_SPI1)
100 PS2_0_ACT (PS2_0)
101 PS2_1_ACT (PS2_1)
102 PS2_2_ACT (PS2_2)
111 TIMER (RTOS)
112 HTM0
113 HTM1
114 ALARM_INT (WEEK)
115 WKSUB (WEEK)
116 WKSEC (WEEK)
117 WKSUBSEC (WEEK)
118 SYSPWR (WEEK)
119 RTC
120 RTC_ALARM (RTC)
121 OVRD_IN (VCI)
122 IN0 (VCI)
123 IN1 (VCI)
124 IN2 (VCI)
125 IN3 (VCI)
126 IN4 (VCI)
127 IN5 (VCI)
128 IN6 (VCI)
129 PS2_0A_WK (PS2_0)
130 PS2_0B_WK (PS2_0)
131 PS2_1A_WK (PS2_1)
132 PS2_1B_WK (PS2_1)
133 PS2_2_WK (PS2_2)
135 KMS
136 TIMER16_0
137 TIMER16_1
138 TIMER16_2
139 TIMER16_3
140 TIMER32_0
141 TIMER32_1
142 CNT_TMR0
143 CNT_TMR1
144 CNT_TMR2
145 CNT_TMR3
146 CAPTURE_TIMER (CCT)
147 CAPTURE_0 (CCT)
148 CAPTURE_1 (CCT)
149 CAPTURE_2 (CCT)
150 CAPTURE_3 (CCT)
151 CAPTURE_4 (CCT)
152 CAPTURE_5 (CCT)
153 COMPARE_0 (CCT)
154 COMPARE_1 (CCT)
155 EEPROM

## Notices in the file
Copyright (c) 2023 Microchip Technology Inc.
SPDX-License-Identifier: Apache-2.0
Licensed under the Apache License, Version 2.0 (the "License");
you may not use this file except in compliance with the License.
You may obtain a copy of the License at
http://www.apache.org/licenses/LICENSE-2.0
Unless required by applicable law or agreed to in writing, software
distributed under the License is distributed on an "AS IS" BASIS,
WITHOUT WARRANTIES OR CONDITIONS OF ANY KIND, either express or implied.
See the License for the specific language governing permissions and
limitations under the License.
