# MEC1727N_B0_SZ register map
Vendor: Microchip Technology; Series: MEC172x; File version: 0
CPU: CM4 r1p0, little endian, MPU, FPU, 3 interrupt priority bits, 172 interrupts
Registers are 32-bit, read-write, reset 0x0 unless marked. A register's access mark holds for its fields unless they carry their own. Offsets are from the block's base; [hi:lo] are bit positions; lines under a group give offsets from that group.

## ECIA — The ECIA works in conjunction with the processor interrupt interface to handle hardware interrupts andd exceptions.
Base 0x4000E000
0x00 SRC8 — GIRQ8 SOURCE
0x04 EN_SET8 — GIRQ8 ENABLE SET
0x08 RESULT8 ro — GIRQ8 RESULT
0x0C EN_CLR8 — GIRQ8 ENABLE CLEAR
0x14 SRC9 — GIRQ9 SOURCE
0x18 EN_SET9 — GIRQ9 ENABLE SET
0x1C RESULT9 ro — GIRQ9 RESULT
0x20 EN_CLR9 — GIRQ9 ENABLE CLEAR
0x28 SRC10 — GIRQ10 SOURCE
0x2C EN_SET10 — GIRQ10 ENABLE SET
0x30 RESULT10 ro — GIRQ10 RESULT
0x34 EN_CLR10 — GIRQ10 ENABLE CLEAR
0x3C SRC11 — GIRQ11 SOURCE
0x40 EN_SET11 — GIRQ11 ENABLE SET
0x44 RESULT11 ro — GIRQ11 RESULT
0x48 EN_CLR11 — GIRQ11 ENABLE CLEAR
0x50 SRC12 — GIRQ12 SOURCE
0x54 EN_SET12 — GIRQ12 ENABLE SET
0x58 RESULT12 ro — GIRQ12 RESULT
0x5C EN_CLR12 — GIRQ12 ENABLE CLEAR
0x64 SRC13 — GIRQ13 SOURCE
0x68 EN_SET13 — GIRQ13 ENABLE SET
0x6C RESULT13 ro — GIRQ13 RESULT
0x70 EN_CLR13 — GIRQ13 ENABLE CLEAR
0x78 SRC14 — GIRQ14 SOURCE
0x7C EN_SET14 — GIRQ14 ENABLE SET
0x80 RESULT14 ro — GIRQ14 RESULT
0x84 EN_CLR14 — GIRQ14 ENABLE CLEAR
0x8C SRC15 — GIRQ15 SOURCE
0x90 EN_SET15 — GIRQ15 ENABLE SET
0x94 RESULT15 ro — GIRQ15 RESULT
0x98 EN_CLR15 — GIRQ15 ENABLE CLEAR
0xA0 SRC16 — GIRQ16 SOURCE
0xA4 EN_SET16 — GIRQ16 ENABLE SET
0xA8 RESULT16 ro — GIRQ16 RESULT
0xAC EN_CLR16 — GIRQ16 ENABLE CLEAR
0xB4 SRC17 — GIRQ17 SOURCE
0xB8 EN_SET17 — GIRQ17 ENABLE SET
0xBC RESULT17 ro — GIRQ17 RESULT
0xC0 EN_CLR17 — GIRQ17 ENABLE CLEAR
0xC8 SRC18 — GIRQ18 SOURCE
0xCC EN_SET18 — GIRQ18 ENABLE SET
0xD0 RESULT18 ro — GIRQ18 RESULT
0xD4 EN_CLR18 — GIRQ18 ENABLE CLEAR
0xDC SRC19 — GIRQ19 SOURCE
0xE0 EN_SET19 — GIRQ19 ENABLE SET
0xE4 RESULT19 ro — GIRQ19 RESULT
0xE8 EN_CLR19 — GIRQ19 ENABLE CLEAR
0xF0 SRC20 — GIRQ20 SOURCE
0xF4 EN_SET20 — GIRQ20 ENABLE SET
0xF8 RESULT20 ro — GIRQ20 RESULT
0xFC EN_CLR20 — GIRQ20 ENABLE CLEAR
0x104 SRC21 — GIRQ21 SOURCE
0x108 EN_SET21 — GIRQ21 ENABLE SET
0x10C RESULT21 ro — GIRQ21 RESULT
0x110 EN_CLR21 — GIRQ21 ENABLE CLEAR
0x118 SRC22 — GIRQ22 SOURCE
0x11C EN_SET22 — GIRQ22 ENABLE SET
0x120 RESULT22 ro — GIRQ22 RESULT
0x124 EN_CLR22 — GIRQ22 ENABLE CLEAR
0x12C SRC23 — GIRQ23 SOURCE
0x130 EN_SET23 — GIRQ23 ENABLE SET
0x134 RESULT23 ro — GIRQ23 RESULT
0x138 EN_CLR23 — GIRQ23 ENABLE CLEAR
0x140 SRC24 — GIRQ24 SOURCE
0x144 EN_SET24 — GIRQ24 ENABLE SET
0x148 RESULT24 ro — GIRQ24 RESULT
0x14C EN_CLR24 — GIRQ24 ENABLE CLEAR
0x154 SRC25 — GIRQ25 SOURCE
0x158 EN_SET25 — GIRQ25 ENABLE SET
0x15C RESULT25 ro — GIRQ25 RESULT
0x160 EN_CLR25 — GIRQ25 ENABLE CLEAR
0x168 SRC26 — GIRQ26 SOURCE
0x16C EN_SET26 — GIRQ26 ENABLE SET
0x170 RESULT26 ro — GIRQ26 RESULT
0x174 EN_CLR26 — GIRQ26 ENABLE CLEAR
0x200 BLK_EN_SET — Block Enable Set Register
  [30:0] VTOR_EN_SET — Each GIRQx bit can be individually enabled to assert an interrupt event. Reads always return the current value of the internal GIRQX_ENABLE bit. The state of the GIRQX_ENABLE bit is determined by the corresponding GIRQX_ENABLE_SET bit and the GIRQX_ENABLE_CLEAR bit. (0=disabled, 1=enabled) (R/WS) 1=Interrupts in the GIRQx Source Register may be enabled 0=No effect.
0x204 BLK_EN_CLR — Block Enable Clear Register.
  [30:0] VTOR_EN_CLR — Each GIRQx bit can be individually disabled to inhibit an interrupt event. Reads always return the current value of the internal GIRQX_ENABLE bit. The state of the GIRQX_ENABLE bit is determined by the corresponding GIRQX_ENABLE_SET bit and the GIRQX_ENABLE_CLEAR bit. (0=disabled, 1=enabled) (R/WC) 1=All interrupts in the GIRQx Source Register are disabled 0=No effect.
0x208 BLK_IRQ_VTOR ro — Block IRQ Vector Register
  [24:0] VTOR — Each bit in this field reports the status of the group GIRQ interrupt assertion to the NVIC. If the GIRQx interrupt is disabled as a group, by the Block Enable Clear Register, then the corresponding bit will be '0'b and no interrupt will be asserted.

## Notices in the file
Copyright (c) 2023 Microchip Technology Inc.
SPDX-License-Identifier: Apache-2.0
Licensed under the Apache License, Version 2.0 (the "License");
you may not use this file except in compliance with the License.
You may obtain a copy of the License at
http://www.apache.org/licenses/LICENSE-2.0
Unless required by applicable law or agreed to in writing, software
distributed under the License is distributed on an "AS IS" BASIS,
WITHOUT WARRANTIES OR CONDITIONS OF ANY KIND, either express or implied.
See the License for the specific language governing permissions and
limitations under the License.
