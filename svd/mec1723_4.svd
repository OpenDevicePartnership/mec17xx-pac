# MEC1723N_B0_LJ register map
Vendor: Microchip Technology; Series: MEC172x; File version: 0
Microchip MEC1723N_B0_LJ Microcontroller
CPU: CM4 r1p0, little endian, MPU, FPU, 3 interrupt priority bits, 172 interrupts
Registers are 32-bit, read-write, reset 0x0 unless marked. A register's access mark holds for its fields unless they carry their own. Offsets are from the block's base; lines under a group give offsets from that group; [hi:lo] are bit positions; {n}, {i} and the like mark numbered series; 'fields as' and 'values as' point back to an identical list; <NAME> marks a mode.

## Memory map
0x40000400 WDT size 0x15 — The function of the Watchdog Timer is to provide a mechanism to detect if the internal embedded controller has failed.
0x40000C00 TIMER16_0 size 0x14 — This 16-bit timer block offers a simple mechanism for firmware to maintain a time base.
0x40000C20 TIMER16_1 size 0x14
0x40000C40 TIMER16_2 size 0x14
0x40000C60 TIMER16_3 size 0x14
0x40000C80 TIMER32_0 size 0x14 — This 32-bit timer block offers a simple mechanism for firmware to maintain a time base.
0x40000CA0 TIMER32_1 size 0x14
0x40000D00 CNTR_TMR0 size 0x10 — This interface is a 16-bit auto-reloading timer/counter.
0x40000D20 CNTR_TMR1 size 0x10
0x40000D40 CNTR_TMR2 size 0x10
0x40000D60 CNTR_TMR3 size 0x10
0x40001000 CCT size 0x34 — This is a 16-bit auto-reloading timer/counter.
0x40001400 RC_ID0 size 0x8 — This interface provides a single pin interface which can discriminate a number of quantized RC constants.
0x40001480 RC_ID1 size 0x8
0x40001500 RC_ID2 size 0x8
0x40002400 DMA_MAIN size 0x8 — DMA Main Registers
0x40002440 DMA_CHAN00 size 0x2C — DMA Channel 00 Registers
0x40002480 DMA_CHAN01 size 0x2C — DMA Channel 01 Registers
0x400024C0 DMA_CHAN02 size 0x19 — DMA Channel 02 Registers
{0x40002440+0x40*n} DMA_CHAN{n:02} size 0x19 (n=3..15)
0x40002C00 EEPROM size 0x40 — This block is the 2K x 8bit EEPROM.
0x40003000 POWERGUARD_0 size 0x24 — This block monitors PowerGuard output signals (or locked rotor signals) from various types of fans, and determines their speed.
0x40003080 POWERGUARD_1 size 0x24
0x40003400 PHOT size 0x18 — This block monitors the PROCHOT# signal and designed to detect single assertions and monitor cumulative PROCHOT active time.
0x40004000 SMB0 size 0x7D — The SMBus interface can handle standard SMBus 2.0 protocols as well as I2C interface.
0x40004400 SMB1 size 0x7D
0x40004800 SMB2 size 0x7D
0x40004C00 SMB3 size 0x7D
0x40005000 SMB4 size 0x7D
0x40005800 PWM0 size 0xC — The PWM block generates an arbitrary duty cycle output at frequencies from less than 0.1 Hz to 24 MHz.
{0x40005800+0x10*n} PWM{n} size 0xC (n=1..11)
0x40006000 TACH0 size 0x10 — This block monitors TACH output signals from various types of fans, and determines their speed
0x40006010 TACH1 size 0x10
0x40006020 TACH2 size 0x10
0x40006030 TACH3 size 0x10
0x40006400 PECI size 0x48 — The PECI Interface allows the EC to retrieve temperature readings from PECI-compliant devices.
0x40007000 SPI_SLAVE size 0x4C
0x40007400 RTOS size 0x10 — RTOS is a 32-bit timer designed to operate on the 32kHz oscillator which is available during all chip sleep states.
0x40007C00 ADC size 0x90 — This block is designed to convert external analog voltage readings into digital values.
0x40008000 SAFBC_EC size 0x214 — SAF BRIDGE COMPONENT
0x40008C00 TFDP size 0x5 — The TFDP serially transmits EC-originated diagnostic vectors to an external debug trace system.
0x40009000 PS2_0 size 0xC — The four PS/2 Ports implementation eliminates the need to bit bang I/O ports to generate PS/2 traffic.
0x40009400 GP_SPI0 size 0x1C — The General Purpose Serial Peripheral Interface (GP-SPI) may be used to communicate with various peripheral devices, e.g., EEPROMS, DACs, ADCs, that use a standard Serial Peripheral Interface.
0x40009480 GP_SPI1 size 0x1C
0x40009800 HTM0 size 0xA — The Hibernation Timer can generate a wake event to the Embedded Controller (EC) when it is in a hibernation mode.
0x40009820 HTM1 size 0xA
0x40009C00 KMS size 0x18 — The Keyboard Scan Interface block provides a register interface to directly scan an external keyboard matrix of size up to 18x8.
0x4000A000 FAN0 size 0x12 — The RPM-PWM Interface is an RPM based Fan Control Algorithm that monitors the fan's speed and automatically adjusts the drive to maintain the desired fan speed. This RPM based Fan Control Algorithm controls a PWM output based on a tachometer input.
0x4000A080 FAN1 size 0x12
0x4000A400 VBAT size 0x38 — The VBAT Register Bank block is a block implemented for miscellaneous battery-backed registers.
0x4000A800 VBAT_RAM size 0xC8 — The VBAT RAM is operational while the main power rail is operational, and will retain its values powered by battery power while the main rail is unpowered.
0x4000AC80 WEEK size 0x28 — The Week Timer and the Sub-Week Timer assert the Power-Up Event Output which automatically powers-up the system from the G3 state
0x4000AE00 VCI size 0x24 — The VBAT-Powered Control Interfaces with the RTC With Date and DST Adjustment as well as the Week Alarm.
0x4000B800 LED0 size 0x18 — The LED is implemented using a PWM that can be driven either by the 48 MHz clock or by a 32.768 KHz clock input.
0x4000B900 LED1 size 0x18
0x4000BA00 LED2 size 0x18
0x4000BB00 LED3 size 0x18
0x4000CD00 BC_LINK0 size 0x10 — This block provides BC-Link connectivity to a slave device. The BC-Link protocol includes a start bit to signal the beginning of a message and a turnaround (TAR) period for bus transfer between the Master and Companion devices.
0x4000E000 ECIA size 0x20C — The ECIA works in conjunction with the processor interrupt interface to handle hardware interrupts andd exceptions.
0x4000F000 SAFBC_CACHE size 0x30 — SAF BRIDGE CACHE INTERFACE
0x4000FC00 EC_REG_BANK size 0x190 — This block is designed to be accessed internally by the EC via the register interface.
0x40010000 CACHE size 0x1190 — This is the CACHE Controller
0x40070000 QMSPI size 0x170 — The QMSPI may be used to communicate with various peripheral devices that use a Serial Peripheral Interface.
0x40071000 SAFCOMM size 0x2BC — This register contains one bit PREFETCH_EN that should be set to '1' during initialization, to enable Prefetch Mode operation in SAFS Mode. Prefetch Mode allows overlapped anticipatory reading of information from Flash during the eSPI delivery of previously-read data to the Host Chipset. If enabled, Prefetching is invoked during consecutive Reads that are 64 bytes in length and from consecutive 64-byte aligned Flash addresses. With roughly equal clock rates on eSPI and SPI, these features together can approximately double the effective bandwidth of consecutive Flash reads performed over eSPI. In SAFS operation (SAF_MODE_ENABLE bit = 1) attempted accesses by EC firmware to this register are blocked.
0x40080100 PCR size 0xEC — The Power, Clocks, and Resets (PCR) Section identifies clock sources, and reset inputs to the chip.
0x40081000 GPIO size 0x7C4 — GPIO Pin Control Registers
0x40082000 OTP size 0x54 — OTP Programming registers.
0x400F0000 MBX size 0x130 — The Mailbox provides a standard run-time mechanism for the host to communicate with the Embedded Controller (EC).
0x400F0400 KBC size 0x331 — The Keyboard Controller is a Host/EC Message Interface with hardware assists to emulate 8042 behavior.
0x400F0800 ACPI_EC0 size 0x10C — The ACPI-ECI provides a four byte full duplex data interface.
0x400F0C00 ACPI_EC1 size 0x10C
0x400F1000 ACPI_EC2 size 0x10C
0x400F1400 ACPI_EC3 size 0x10C
0x400F1800 ACPI_EC4 size 0x10C
0x400F1C00 PM1 size 0x111 — These features comply with the ACPI Specification through a combination of hardware and EC software.
0x400F2000 PORT92 size 0x331 — The registers listed in the Configuration Register Summary table are for a single instance of the Legacy Port92/GATEA20 logic.
0x400F2400 UART0 size 0x3F1 — The 16550 UART is a full-function Two Pin Serial Port that supports the standard RS-232 Interface.
0x400F2800 UART1 size 0x3F1
0x400F3400 ESPI_IO size 0x3F1 — The ESPI is used by the system host to configure the chip and communicate with the logical devices implemented in the design.
0x400F3800 ESPI_MEMORY size 0x3C0 — The eSPI Memory Component is one of two Logical Devices (along with the I/O Component) that provide access to all the registers in the device.
0x400F4000 EMI0 size 0x140 — The EMI provides a communication between system host and Embedded Controller.
0x400F4400 EMI1 size 0x140
0x400F4800 EMI2 size 0x140
0x400F5000 RTC size 0x20 — This is the set of registers that are automatically counted by hardware every 1 second while the block is enabled.
0x400F8000 PORT_80_DEBUG size 0x7F1 — Diagnostic data is written by the Host Interface to the Port 80 BIOS Debug Port.
0x400F9C00 ESPI_MSVW00_06 size 0x54 — The Virtual Wire Channel permits the System to emulate a set of wires that interconnect the system Core Logic with the EC.
0x400F9C54 ESPI_MSVW07_10 size 0x30 — The ESPI VW Channel permits the System to emulate a set of wires that interconnect the system Core Logic with the EC.
0x400F9E00 ESPI_SMVW00_10 size 0x58 — The ESPI VW Channel permits the System to emulate a set of wires that interconnect the system Core Logic with the EC.
0x400FBC00 ESPI_SCRATCH size 0x20 — 32 Byte ESPI Test Register
0x400FC000 ASIF size 0x140 — The ASIF allows the Host and EC to use index addressing to access registers residing in an external IC.
0x400FFF00 GCR size 0x27 — The Logical Device Configuration registers support motherboard designs in which the resources required by their components are known and assigned by the BIOS at POST.
0x40220000 IMSPI size 0x10 — Internal Master SPI.
0xE000E000 SystemControl size 0xD8C — System Control Registers
0xE000E010 SysTick size 0x10 — System timer
0xE000E100 NVIC size 0xE04 — Nested Vectored Interrupt Controller
0xE000EF30 FPU size 0x18 — Floating Point Unit

## Interrupts
0 GIRQ08 (GPIO)
1 GIRQ09 (GPIO)
2 GIRQ10 (GPIO)
3 GIRQ11 (GPIO)
4 GIRQ12 (GPIO)
5 GIRQ13 (SMB0)
6 GIRQ14 (DMA_CHAN00)
7 GIRQ15 (UART0)
9 GIRQ17 (PECI)
10 GIRQ18 (QMSPI)
11 GIRQ19 (ESPI_IO)
12 GIRQ20 (OTP)
13 GIRQ21 (WDT)
14 GIRQ23 (TIMER16_0)
15 GIRQ24 (ESPI_MSVW00_06)
16 GIRQ25 (ESPI_MSVW07_10)
17 GIRQ26 (GPIO)
20 I2CSMB0 (SMB0)
21 I2CSMB1 (SMB1)
22 I2CSMB2 (SMB2)
23 I2CSMB3 (SMB3)
{n+24} DMA_CH{n:02} (DMA_CHAN{n:02}) (n=0..15)
40 UART0
41 UART1
42 EMI0
43 EMI1
44 EMI2
45 AEC0_IBF (ACPI_EC0)
46 AEC0_OBE (ACPI_EC0)
47 AEC1_IBF (ACPI_EC1)
48 AEC1_OBE (ACPI_EC1)
49 AEC2_IBF (ACPI_EC2)
50 AEC2_OBE (ACPI_EC2)
51 AEC3_IBF (ACPI_EC3)
52 AEC3_OBE (ACPI_EC3)
53 AEC4_IBF (ACPI_EC4)
54 AEC4_OBE (ACPI_EC4)
55 APM1_CTL (PM1)
56 APM1_EN (PM1)
57 APM1_STS (PM1)
58 KBC_OBE (KBC)
59 KBC_IBF (KBC)
60 MBOX (MBX)
62 P80CAP0 (PORT_80_DEBUG)
64 ASIF
70 PECI
71 TACH0
72 TACH1
73 TACH2
74 RPM2PWM_0_STALL (FAN0)
75 RPM2PWM_0_SPIN (FAN0)
76 RPM2PWM_1_STALL (FAN1)
77 RPM2PWM_1_SPIN (FAN1)
78 ADC_SNGL (ADC)
79 ADC_RPT (ADC)
80 RC_ID0
81 RC_ID1
82 RC_ID2
83 LED0
84 LED1
85 LED2
86 LED3
87 PHOT
88 POWERGUARD_0
89 POWERGUARD_1
90 SPISLV (SPI_SLAVE)
91 QMSPI
92 TX0 (GP_SPI0)
93 RX0 (GP_SPI0)
94 TX1 (GP_SPI1)
95 RX1 (GP_SPI1)
96 BCM_ERR_0 (BC_LINK0)
97 BCM_BUSY_CLR_0 (BC_LINK0)
100 PS2_0_ACT (PS2_0)
103 INTR_PC (ESPI_IO)
104 INTR_BM1 (ESPI_IO)
105 INTR_BM2 (ESPI_IO)
106 INTR_LTR (ESPI_IO)
107 INTR_OOB_UP (ESPI_IO)
108 INTR_OOB_DOWN (ESPI_IO)
109 INTR_FLASH (ESPI_IO)
110 ESPI_RESET (ESPI_IO)
111 RTMR (RTOS)
112 HTMR0 (HTM0)
113 HTMR1 (HTM1)
114 WK (WEEK)
115 WKSUB (WEEK)
116 WKSEC (WEEK)
117 WKSUBSEC (WEEK)
118 SYSPWR (WEEK)
119 RTC
120 RTC_ALARM (RTC)
121 VCI_OVRD_IN (VCI)
122 VCI_IN0 (VCI)
123 VCI_IN1 (VCI)
124 VCI_IN2 (VCI)
125 VCI_IN3 (VCI)
129 PS2_0A_WAKE (PS2_0)
130 PS2_0B_WAKE (PS2_0)
135 KEYSCAN (KMS)
136 TIMER16_0
137 TIMER16_1
138 TIMER16_2
139 TIMER16_3
140 TIMER32_0
141 TIMER32_1
142 CNTR_TMR0
143 CNTR_TMR1
144 CNTR_TMR2
145 CNTR_TMR3
146 CCT
147 CCT_CAP0 (CCT)
148 CCT_CAP1 (CCT)
149 CCT_CAP2 (CCT)
150 CCT_CAP3 (CCT)
151 CCT_CAP4 (CCT)
152 CCT_CAP5 (CCT)
153 CCT_CMP0 (CCT)
154 CCT_CMP1 (CCT)
155 EEPROM
156 ESPI_VWIRE (ESPI_IO)
158 I2CSMB4 (SMB4)
159 TACH3
166 SAF_DONE (SAFBC_EC)
167 SAF_ERR (SAFBC_EC)
171 WDT

## Notices in the file
Copyright (c) 2023 Microchip Technology Inc.
SPDX-License-Identifier: Apache-2.0
Licensed under the Apache License, Version 2.0 (the "License");
you may not use this file except in compliance with the License.
You may obtain a copy of the License at
http://www.apache.org/licenses/LICENSE-2.0
Unless required by applicable law or agreed to in writing, software
distributed under the License is distributed on an "AS IS" BASIS,
WITHOUT WARRANTIES OR CONDITIONS OF ANY KIND, either express or implied.
See the License for the specific language governing permissions and
limitations under the License.
